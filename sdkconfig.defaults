## sdkconfig.defaults
```kconfig
# TLS certificate bundle for HTTPS
CONFIG_MBEDTLS_CERTIFICATE_BUNDLE=y
CONFIG_MBEDTLS_CERTIFICATE_BUNDLE_DEFAULT_FULL=y

# Increase stack for main task (needs room for TLS handshake)
CONFIG_ESP_MAIN_TASK_STACK_SIZE=8192

# WiFi
CONFIG_ESP_WIFI_STATIC_RX_BUFFER_NUM=4
CONFIG_ESP_WIFI_DYNAMIC_RX_BUFFER_NUM=8

# Disable watchdog on idle (we block in HTTP calls)
CONFIG_ESP_TASK_WDT_INIT=n
```
